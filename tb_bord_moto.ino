
///////////////////////////////
////  Alexandre OGER 2015  ////
///////////////////////////////


// afficheur tb de bord moto multifonctions


//afficheur oled 1.5 pouces 65535 couleurs 128x128 sur bus SPI
// capteur 6 positions sur la boite de vitesse (N-1-2-3-4-5) relié à un pont diviseur de tension et lecture sur pin analogique
// GPS sur port serie pour infos horloge et vitesse
// capteur de temp exterieur sur bus onewire



/*|
                              
                                            ________| |__
       ----SPI MOSI (Oled)    MOSI          | |()|  | | | SCK   ----SPI SCLOCK (Oled) 
                              RX_LED/SS     |       | | | MISO
                              1/TX          |      ICSP | VIN   -------- Alim moto
                              0/RX          |           | GND   ------- Masse oled+gps+moto
                              RESET         |           | RESET
                              GND           |           | +5V   ------- VCC oled + GPS
       ----SPI DC (Oled)       2/SDA        | ARDUINO   | NC
       ----SPI CS (Oled)       3(PWM)/SCL   |           | NC
       ----SPI RST (Oled)     4/A6          |           | A5    
                              5 (PWM)       |   MICRO   | A4      
 capteur BV (0-5V analogique) 6 (PWM)/A7    |           | A3       
                              7             |           | A2        
       ----RX soft (GPS)      8/A9          |           | A1  
       ----TX soft (GPS)      9 (PWM)/A10   |           | A0    
       ----one wire (temp)    10 (PWM) /A11 |           | AREF
                              11(PWM)       |   _____   | 3.3V
     ----BP (heure ete/hiver) 12 (PWM)/A12  |  [ USB ]  | 13 (PWM)
                                            ----|___|---

*/



//conf onewire
#include <OneWire.h>
OneWire  ds(10);
//a changer si autre capteur avec une autre id
byte addr[8]= {0x28, 0xFF, 0xEF, 0xA2, 0x61, 0x15, 0x02, 0xF2};


//conf gps
#include <TinyGPS++.h>
#include <SoftwareSerial.h>
static const int RXPin = 8, TXPin = 9;
static const uint32_t GPSBaud = 4800;
TinyGPSPlus gps;
SoftwareSerial ss(RXPin, TXPin);


//conf eprom (heurehive/ete)
#include <EEPROM.h>


//conf ecran oled
#define dc   2
#define cs   3
#define rst  4
#include <Adafruit_GFX.h>
#include <Adafruit_SSD1351.h>
#include <SPI.h>
Adafruit_SSD1351 tft = Adafruit_SSD1351(cs, dc, rst);


//definition des couleurs (RGB 565 - 16bits)
int16_t BLACK=0x0000;
int16_t WHITE=0xFFFF;
int16_t BLUE=0x041F;
int16_t RED=0xF800;
int16_t YELLOW=0xFFE0;
int16_t ORANGE=0xFC00;
int16_t GREEN=0x07E0;
int16_t GRAY=0x8410;
int16_t LIGHTGRAY= 0xE73C;


int16_t couleur_fond=BLACK;
int16_t couleur_pixel=ORANGE;
int16_t couleur_horloge=GRAY;
int16_t couleur_vitesse=ORANGE;
int16_t couleur_temp=RED;
int16_t couleur_N=GREEN;
int16_t couleur_1=YELLOW;
int16_t couleur_2=YELLOW;
int16_t couleur_3=ORANGE;
int16_t couleur_4=ORANGE;
int16_t couleur_5=RED;
int16_t couleur_ligne=WHITE;
int16_t couleur_vitesse_fixe=GREEN;


//variables diverses
uint8_t cligno=0;
uint8_t gpsok=0;
uint8_t sensorVal;
uint8_t rapport=12;
uint8_t rapport_courant=12;
uint8_t compte=0;

uint8_t BP=12;
uint8_t BV=A7;


uint8_t heure_courante=99;
uint8_t minute_courante=99;
uint8_t heures;
uint8_t minutes;
uint8_t mois_courant=99;
uint8_t jour_courant=99;
uint8_t quinzaine_courante=99;
uint8_t jour_nuit=99;
uint8_t jour_nuit_courant=1;
int     vitesse_courante=999;
uint8_t temp_courante=99;
uint8_t offset_temps;


//declaration des données levé/couché du soleil par quinzaine (24 plages horaire/an)
int horaires_soleil[24][4] = { 
    //janvier
    {8,45,17,25},
    {8,30,17,55},
    //fevrier
    {8,10,18,15},
    {7,45,18,30},
    //mars
    {7,15,18,50},
    {7,0,19,20},
    //avril
    {7,15,20,40},
    {7,0,21,10},
    //mai
    {7,0,21,40},
    {7,0,22,00},
    //juin
    {7,0,22,35},
    {7,0,22,50},
    //juillet
    {7,0,22,40},
    {7,0,22,10},
    //aout
    {7,0,21,40},
    {7,0,21,10},
    //septembre
    {7,0,20,40},
    {7,15,20,00},
    //octobre
    {7,30,19,30},
    {8,10,19,00},
    //novembre
    {7,45,17,45},
    {8,10,17,30},
    //decembre
    {8,30,17,10},
    {8,45,17,10}
 };
  


// conf des images bitmap (police 0-9, Rapport engagé N12345, chaines: km/h, T°) généré avec "the dot factory"
#include <avr/pgmspace.h>
const PROGMEM uint8_t nombreBitmaps[] = 
{
    // @0 '0' (14 pixels wide)
  0x0F, 0xC0, //     ######    
  0x1F, 0xE0, //    ########   
  0x3F, 0xF0, //   ##########  
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  0x0F, 0xC0, //     ######    

  // @40 '1' (14 pixels wide)
  0x01, 0xC0, //        ###    
  0x03, 0xC0, //       ####    
  0x07, 0xC0, //      #####    
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  0x03, 0xC0, //       ####    

  // @80 '2' (14 pixels wide)
  0x0F, 0xC0, //     ######    
  0x3F, 0xF0, //   ##########  
  0x7F, 0xF8, //  ############ 
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  0xFF, 0xFC, // ##############

  // @120 '3' (14 pixels wide)
  0x0F, 0x80, //     #####     
  0x3F, 0xE0, //   #########   
  0x7F, 0xF0, //  ###########  
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  0x0F, 0xC0, //     ######    

  // @160 '4' (14 pixels wide)
  0x00, 0xF0, //         ####  
  0x00, 0xF0, //         ####  
  0x01, 0xF0, //        #####  
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  0x00, 0xF0, //         ####  

  // @200 '5' (14 pixels wide)
  0x3F, 0xF8, //   ########### 
  0x3F, 0xF8, //   ########### 
  0x3F, 0xF8, //   ########### 
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  0x0F, 0xC0, //     ######    

  // @240 '6' (14 pixels wide)
  0x07, 0xC0, //      #####    
  0x1F, 0xF0, //    #########  
  0x3F, 0xF8, //   ########### 
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  0x07, 0xC0, //      #####    

  // @280 '7' (14 pixels wide)
  0xFF, 0xFC, // ##############
  0xFF, 0xFC, // ##############
  0xFF, 0xFC, // ##############
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  0x1E, 0x00, //    ####       

  // @320 '8' (14 pixels wide)
  0x0F, 0xC0, //     ######    
  0x3F, 0xF0, //   ##########  
  0x7F, 0xF8, //  ############ 
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  0x0F, 0xC0, //     ######    

  // @360 '9' (14 pixels wide)
  0x0F, 0x80, //     #####     
  0x3F, 0xE0, //   #########   
  0x7F, 0xF0, //  ###########  
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  0x1F, 0x80, //    ######     
};

struct FONT_CHAR_INFO
{
  uint8_t  width;   // width in bits
  uint8_t  height;  // char height in bits
  uint16_t offset;  // offset of char into char array
};
// Character descriptors for Arial 21pt
// { [Char width in bits], [Char height in bytes], [Offset into arial_21ptCharBitmaps in bytes] }
const FONT_CHAR_INFO nombreDescriptors[] = 
{
  {14, 3, 0},       // 0 
  {14, 3, 40},      // 1 
  {14, 3, 80},      // 2 
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  {14, 3, 360},     // 9 
};

const PROGMEM uint8_t  tempBitmaps[] =
{

  0xFF, 0xE0, 0x78,// ###########   ####
  0xFF, 0xE0, 0xFC,// ###########  ######
  0xFF, 0xE0, 0xCC,// ###########  ##  ##
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  0x0E, 0x00, 0x00,//     ###     
};




const PROGMEM uint8_t  kmhBitmaps[] =
{
  0xE0, 0x00, 0x00, 0x03, 0x70, 0x00, // ###                           ## ###       
  0xE0, 0x00, 0x00, 0x03, 0x70, 0x00, // ###                           ## ###       
  0xE0, 0x00, 0x00, 0x06, 0x70, 0x00, // ###                          ##  ###       
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  0xE3, 0x9C, 0x71, 0xD8, 0x70, 0xE0, // ###   ###  ###   ###   ### ##    ###    ###
};

const PROGMEM uint8_t  _5Bitmaps[] =
{
  0x01, 0xFF, 0xFF, 0xFF, 0xFF, 0xF0, //        #####################################   
  0x01, 0xFF, 0xFF, 0xFF, 0xFF, 0xF0, //        #####################################   
  0x01, 0xFF, 0xFF, 0xFF, 0xFF, 0xF0, //        #####################################   
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  0x00, 0x00, 0x3F, 0xF8, 0x00, 0x00, //                   ###########                                       
};

const PROGMEM uint8_t  _4Bitmaps[] =
{
  0x00, 0x00, 0x00, 0x07, 0xFF, 0x80, 0x00, //                              ############        
  0x00, 0x00, 0x00, 0x07, 0xFF, 0x80, 0x00, //                              ############        
  0x00, 0x00, 0x00, 0x0F, 0xFF, 0x80, 0x00, //                             #############        
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  0x00, 0x00, 0x00, 0x0F, 0xFF, 0x80, 0x00, //                             #############           
};

const PROGMEM uint8_t  _3Bitmaps[] =
{
  0x00, 0x00, 0x7F, 0xE0, 0x00, 0x00, //                  ##########                  
  0x00, 0x07, 0xFF, 0xFC, 0x00, 0x00, //              #################               
  0x00, 0x1F, 0xFF, 0xFF, 0x00, 0x00, //            #####################             
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  0x00, 0x00, 0x7F, 0xE0, 0x00, 0x00, //                  ##########                               
};

const PROGMEM uint8_t  _2Bitmaps[] =
{
  0x00, 0x00, 0x3F, 0xF8, 0x00, 0x00, //                   ###########                
  0x00, 0x03, 0xFF, 0xFF, 0x80, 0x00, //               ###################            
  0x00, 0x0F, 0xFF, 0xFF, 0xE0, 0x00, //             #######################          
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  0xFF, 0xFF, 0xFF, 0xFF, 0xFF, 0xF8, // #############################################
};

const PROGMEM uint8_t  _1Bitmaps[] =
{
  0x00, 0x00, 0x1F, 0xFC, //                    ###########
  0x00, 0x00, 0x1F, 0xFC, //                    ###########
  0x00, 0x00, 0x3F, 0xFC, //                   ############
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  0x00, 0x00, 0x7F, 0xFC, //                  #############
};

const PROGMEM uint8_t nBitmaps[] =
{
  0xFF, 0xF0, 0x00, 0x00, 0x03, 0xFF, 0xC0, // ############                          ############
  0xFF, 0xF8, 0x00, 0x00, 0x03, 0xFF, 0xC0, // #############                         ############
  0xFF, 0xFC, 0x00, 0x00, 0x03, 0xFF, 0xC0, // ##############                        ############
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  0xFF, 0xF0, 0x00, 0x00, 0x07, 0xFF, 0xC0, // ############                         #############
};



void setup() {
  
  pinMode(BP,INPUT_PULLUP); //bp pour passage heure d'ete/heure d'hiver
  pinMode(BV,INPUT);//capteur BV lecture tension sur 
 
  ss.begin(GPSBaud);

  
 // Serial.begin(9600);
 // while (!Serial) {
 //   ; // wait for serial port to connect. Needed for native USB
 // }
 
   
  
  tft.begin();

  //bus 1
  ds.reset();  
  ds.select(addr);
  ds.reset();
  ds.select(addr);  

  /*
   ds.write(0x4E);     //indique que l'on va ecrire dans la ram     
   ds.write(0x4B);    // valeur par defaut de l'alarme temp haute
   ds.write(0x46);    // valeur par defaut de l'alarme temp basse
   ds.write(0x1F);    // 9-bit = 0.5 deg
   ds.reset();
  */ 

  anim_demarrage();
  
  check_temp();

  //lecture decalage heure ete/hiver
  offset_temps=EEPROM.read(1);

 // Serial.println("OK !!");

}



void loop() {

     verif_rapport();
     smartDelay(500);
     
     sensorVal = digitalRead(BP);
     if (sensorVal == LOW) {
        heure_hiver_ete();
     }
     
     if (compte==6){
       check_temp();
       compte=0;
     }
    
    verif_rapport();
    
    if(gpsok==1){ 
        recup_gps();
        if (compte==0){
           check_jour_nuit();
        }
    }else{
       check_gps();
    }

    compte++;
}



void smartDelay(unsigned long ms){
  
    tft.setTextColor(couleur_fond);
    tft.setTextSize(1);
    tft.setCursor(122,0);
    tft.write('O'); 
    unsigned long start = millis();
    do{
      while (ss.available()) {
        gps.encode(ss.read());
      }
    }while (millis() - start < ms);
    tft.setTextColor(couleur_pixel);
    tft.setTextSize(1);
    tft.setCursor(122,0);
    tft.write('O');
    
}



void check_gps(){
  
   for(uint8_t j=0;j<11;j++){
      verif_rapport();
      if(gps.location.isValid()){
        gpsok=1;
        break;
      }
      delay(500);   
   }
   
}



void check_jour_nuit(){

    mois_courant=gps.date.month();
    jour_courant=gps.date.day();    
    if (jour_courant<15){
        quinzaine_courante=2*mois_courant-2;
    } else {
        quinzaine_courante=2*mois_courant-1;  
    }    
    int heure_debut=horaires_soleil[quinzaine_courante][0];
    int minute_debut=horaires_soleil[quinzaine_courante][1];
    int heure_fin=horaires_soleil[quinzaine_courante][2];
    int minute_fin=horaires_soleil[quinzaine_courante][3];
    int timestamp_debut=heure_debut*minute_debut;
    int timestamp_fin=heure_fin*minute_fin;
    int timestamp_courant=heures*minutes;

    //Serial.println(timestamp_debut);
    //Serial.println(timestamp_courant);
    //Serial.println(timestamp_fin);

   if( timestamp_courant>=timestamp_debut && timestamp_courant<=timestamp_fin) {
      jour_nuit=0;
   }  else {
      jour_nuit=1;
   }

  if(jour_nuit!=jour_nuit_courant) {
    if(jour_nuit==1) {
        jour_nuit_courant=1;     
        couleur_fond=BLACK;
        couleur_pixel=ORANGE;
        couleur_ligne=WHITE;
        couleur_horloge=GRAY;
        couleur_vitesse=ORANGE;
        couleur_vitesse_fixe=GREEN;
        couleur_temp=RED;
        couleur_N=GREEN;
        couleur_1=YELLOW;
        couleur_2=YELLOW;
        couleur_3=ORANGE;
        couleur_4=ORANGE;
        couleur_5=RED;
     } else {
        jour_nuit_courant=0;
        couleur_fond=LIGHTGRAY;
        couleur_pixel=BLACK;
        couleur_ligne=BLACK;
        couleur_horloge=BLACK;
        couleur_vitesse=BLACK;
        couleur_vitesse_fixe=RED;
        couleur_temp=RED;
        couleur_N=GREEN;
        couleur_1=BLACK;
        couleur_2=BLACK;
        couleur_3=BLACK;
        couleur_4=BLACK;
        couleur_5=RED;
    }
    //reset et réaffichage des données    
    dessine_fond();
    rapport_courant=12;
    verif_rapport();
    heure_courante=99;
    minute_courante=99;
    vitesse_courante=999;
    recup_gps();
    temp_courante=99;
    check_temp();
  }  
}




void heure_hiver_ete(){
  if(offset_temps==1){
    EEPROM.write(1, 2);
    offset_temps=2;
  }else{
    EEPROM.write(1, 1);
    offset_temps=1;
  } 
  recup_gps();
  delay(1000);
}


  
void recup_gps(){
  
  char buf [4]; 
    
  //horloge
  heures=gps.time.hour()+offset_temps;
  minutes=gps.time.minute();
  //Serial.print("temps: ");
  //Serial.print(heures);
  //Serial.print(":");
  //Serial.println(minutes);
  if(heures !=heure_courante){
    if(heure_courante!=99){
      tft.fillRect(7, 96, 30, 20, couleur_fond);
    }
    sprintf(buf, "%02d", gps.time.hour()+offset_temps);
    aff_nombre(buf,7,96,couleur_horloge,0);
    heure_courante=heures;
  }
   if(minutes !=minute_courante){
    if(minute_courante!=99){
      tft.fillRect(50, 96, 30, 20, couleur_fond);
    }
    sprintf(buf, "%02d", gps.time.minute());
    aff_nombre(buf,50,96,couleur_horloge,0);
    minute_courante=minutes;
  }
  
  //vitesse
  int vi = abs((int)gps.speed.kmph());
  //Serial.print("vitesse: ");
  //Serial.println(vi);
  if(vi !=vitesse_courante){
    if(vitesse_courante!=999){
      tft.fillRect(85, 20, 46, 20, couleur_fond);
    }
    sprintf (buf, "%03i", vi);
    aff_nombre(buf,85,20,couleur_vitesse,1);
    vitesse_courante=vi;
  } 
}




void check_temp(){
  //Serial.print("temperature: "); 
  byte i;
  byte data[12];
  int  celsius;

  /*
  if ( !ds.search(addr)) {
    ds.reset_search();
    delay(200);
    Serial.println("pas cool"); 
    return;
  }
  if (OneWire::crc8(addr, 7) != addr[7]) {
      Serial.println("pas cool2"); 
      return;
  }
  for ( i = 0; i < 8; i++) {          
    Serial.println(addr[i]);  
  }
  */

  ds.reset();
  ds.select(addr);
  ds.write(0x44, 1);     
  delay(150);     
  ds.reset();
  ds.select(addr);    
  ds.write(0xBE);        
  for ( i = 0; i < 9; i++) {          
    data[i] = ds.read();
  }

  int16_t raw = (data[1] << 8) | data[0];
  byte cfg = (data[4] & 0x60);
  if (cfg == 0x00) raw = raw & ~7;  // 9 bit resolution, 93.75 ms
  else if (cfg == 0x20) raw = raw & ~3; // 10 bit res, 187.5 ms
  else if (cfg == 0x40) raw = raw & ~1; // 11 bit res, 375 ms
  //// default is 12 bit resolution, 750 ms conversion time
  celsius = round((float)raw / 16.0);
  aff_temp(celsius);
  //Serial.println(celsius);
}



void aff_temp(int valeur){

  char buf [4];
  if(valeur !=temp_courante){
    if(temp_courante!=99){
      tft.fillRect(93, 103, 30, 21, couleur_fond);
    }
    sprintf (buf, "%02i", valeur);
    aff_nombre(buf,93,103,RED,0);
    temp_courante=valeur;
  }
}



void aff_nombre(char chaine[4],int posx,int posy,int16_t couleur,int type){
  
  int compteur=0;
  int ok=0;
  byte Bitmaps[41];
  int val;
  int offset_local;
  for(int i=0;i<4;i++){
    if(chaine[i]=='\0'){
      break;
    }
    if(chaine[i]=='0' && i!=2 && type==1 && ok==0){
      tft.fillRect(posx+i*14+compteur, posy, 14, 20, couleur_fond);
    }else{
     ok=1;
     switch (chaine[i]) {
        case '0':
          offset_local=nombreDescriptors[0].offset;
        break;
        case '1':
          offset_local=nombreDescriptors[1].offset;
        break;
        case '2':
          offset_local=nombreDescriptors[2].offset;
        break;
        case '3':
          offset_local=nombreDescriptors[3].offset;
        break;
        case '4':
          offset_local=nombreDescriptors[4].offset;
        break;
        case '5':
          offset_local=nombreDescriptors[5].offset;
        break;  
        case '6':
          offset_local=nombreDescriptors[6].offset;
        break;
        case '7':
          offset_local=nombreDescriptors[7].offset;
        break;
        case '8':
          offset_local=nombreDescriptors[8].offset;
        break;
        case '9':
          offset_local=nombreDescriptors[9].offset;
        break;                                                                   
      }
      for(int j=0;j<40;j++){ 
        val=offset_local+j;
        Bitmaps[j]=pgm_read_byte(nombreBitmaps+val);
      }
      tft.drawRamBitmap(posx+i*14+compteur, posy,Bitmaps, 14, 20, couleur);
      compteur=compteur+2;
    }
  } 
  
}




void verif_rapport(){
  
     //Serial.println("rapport");
     int capteur_boite = analogRead(BV);
     
     if (capteur_boite > 460 && capteur_boite < 535) {
        rapport=5;
        if (rapport!=rapport_courant) {
          aff_rapport(5);
          rapport_courant=rapport;
        }
        //Serial.println("5");
        return;
     }
     if (capteur_boite > 540 && capteur_boite < 595) {
        rapport=4;
        if (rapport!=rapport_courant) {
          aff_rapport(4);
          rapport_courant=rapport;
        }
        //Serial.println("4");
        return;
     }
     if (capteur_boite > 596 && capteur_boite < 660) {
        rapport=3;
        if (rapport!=rapport_courant) {
          aff_rapport(3);
          rapport_courant=rapport;
        }
        //Serial.println("3");
        return;
     }
     if (capteur_boite > 346 && capteur_boite < 459) {
        rapport=2;
        if (rapport!=rapport_courant) {
          aff_rapport(2); 
          rapport_courant=rapport;
        }
        //Serial.println("2");
        return;
     }
     if (capteur_boite > 50 && capteur_boite < 240) {
        rapport=1;
        if (rapport!=rapport_courant) {
          aff_rapport(1);
          rapport_courant=rapport;
        }
        //Serial.println("1");
        return;
     }
     if (capteur_boite > 241 && capteur_boite < 345) {
        rapport=0;
        if (rapport!=rapport_courant) {
          aff_rapport(0);
          rapport_courant=rapport;
        }
        //Serial.println("N");
        return;
     }
 
}


  
void aff_rapport(uint8_t valeur)
{
   tft.fillRect(0, 0, 61, 79, couleur_fond);
   switch (valeur) {
    case 0:
      tft.drawBitmap(3, 7, nBitmaps, 56, 64, couleur_N);
      //Serial.println("N");
      break;
    case 1:
      tft.drawBitmap(11, 2, _1Bitmaps, 32, 68, couleur_1);
      //Serial.println("1");    
      break;
     case 2:
      tft.drawBitmap(7, 2, _2Bitmaps, 48, 68, couleur_2); 
      //Serial.println("2");
      break;
     case 3:
      tft.drawBitmap(7, 2, _3Bitmaps, 48, 69, couleur_3);
      //Serial.println("3");
      break;
     case 4:
      tft.drawBitmap(7, 2, _4Bitmaps, 56, 67, couleur_4);
      //Serial.println("4");
      break;
     case 5:
      tft.drawBitmap(7, 2, _5Bitmaps, 48, 69, couleur_5);
      //Serial.println("5");
      break;
  }   
}




void anim_demarrage(){

  //Serial.println("debut anim oled");

   tft.fillScreen(BLACK);

   tft.setTextColor(WHITE);
   tft.setTextSize(2);
   tft.setCursor(0,111);
   tft.print("(c) A.Oger");
   delay(700);
   
   tft.setTextColor(WHITE);
   tft.setRotation(1);
   tft.setTextSize(6);
   tft.setCursor(0,40);
   tft.print(":-)");
   delay(2500);
   
   tft.fillScreen(BLACK);
   
   tft.fillScreen(BLUE);
   delay(300);
   tft.fillScreen(GREEN);
   delay(300);
   tft.fillScreen(RED);
   delay(300);
   tft.fillScreen(GRAY);
   delay(300);
   tft.fillScreen(ORANGE);
   delay(300);


   tft.fillScreen(couleur_fond);

   tft.setRotation(0);
   for(uint8_t i=0;i<12;i++){
      tft.drawFastVLine(i*10, 0, 128, BLACK);
      tft.drawFastHLine(0, i*10, 128, BLACK);
      delay(100);
   }
   for(int i=0;i<12;i++){
      tft.drawFastVLine(i*10, 0, 128, WHITE);
      tft.drawFastHLine(0, i*10, 128, WHITE);
      delay(100);
   }

   for(int i=0;i<16;i++){
     if (i>0){
      tft.drawLine(0, 5*(i-1), 128, 5*(i-1), BLACK);
     }
     tft.drawLine(0, 5*i, 128, 5*i, WHITE);
     delay(40);
   }
   
   dessine_fond();
   //Serial.println("fin anim oled");
}


void dessine_fond(){

   tft.fillScreen(couleur_fond);
   tft.drawLine(0, 80, 128, 80, couleur_ligne);
   tft.drawLine(0, 81, 128, 81, couleur_ligne);
   for(int i=80;i>=0;i--){
     tft.drawPixel(62, i, couleur_ligne);
     tft.drawPixel(63, i, couleur_ligne);
     delay(15);
   }
   for(int i=80;i<129;i++){
     tft.drawPixel(85, i,couleur_ligne);
     tft.drawPixel(86, i,couleur_ligne);
     delay(15);
   }
  tft.drawBitmap(80, 50, kmhBitmaps, 48, 14, couleur_vitesse_fixe);
  tft.drawBitmap(102, 85, tempBitmaps, 24, 14, couleur_temp);
  tft.setCursor(36,96);
  tft.setTextSize(3);
  tft.setTextColor(couleur_horloge);
  tft.print(":");
  
}

  /*
  // @0 '0' (14 pixels wide)
  0x0F, 0x80, //     #####     
  0x3F, 0xE0, //   #########   
  0x70, 0x70, //  ###     ###  
  0x60, 0x30, //  ##       ##  
  0x60, 0x30, //  ##       ##  
  0xC0, 0x18, // ##         ## 
  0xC0, 0x18, // ##         ## 
  0xC0, 0x18, // ##         ## 
  0xC0, 0x18, // ##         ## 
  0xC0, 0x18, // ##         ## 
  0xC0, 0x18, // ##         ## 
  0xC0, 0x18, // ##         ## 
  0xC0, 0x18, // ##         ## 
  0xC0, 0x18, // ##         ## 
  0xC0, 0x18, // ##         ## 
  0x60, 0x30, //  ##       ##  
  0x60, 0x30, //  ##       ##  
  0x70, 0x70, //  ###     ###  
  0x3F, 0xE0, //   #########   
  0x0F, 0x80, //     #####     

  // @40 '1' (14 pixels wide)
  0x01, 0x80, //        ##     
  0x01, 0x80, //        ##     
  0x07, 0x80, //      ####     
  0x0F, 0x80, //     #####     
  0x3F, 0x80, //   #######     
  0x79, 0x80, //  ####  ##     
  0x61, 0x80, //  ##    ##     
  0x01, 0x80, //        ##     
  0x01, 0x80, //        ##     
  0x01, 0x80, //        ##     
  0x01, 0x80, //        ##     
  0x01, 0x80, //        ##     
  0x01, 0x80, //        ##     
  0x01, 0x80, //        ##     
  0x01, 0x80, //        ##     
  0x01, 0x80, //        ##     
  0x01, 0x80, //        ##     
  0x01, 0x80, //        ##     
  0x01, 0x80, //        ##     
  0x01, 0x80, //        ##     

  // @80 '2' (14 pixels wide)
  0x0F, 0xC0, //     ######    
  0x3F, 0xE0, //   #########   
  0x70, 0x70, //  ###     ###  
  0x60, 0x38, //  ##       ### 
  0xC0, 0x18, // ##         ## 
  0xC0, 0x18, // ##         ## 
  0x00, 0x18, //            ## 
  0x00, 0x18, //            ## 
  0x00, 0x30, //           ##  
  0x00, 0x70, //          ###  
  0x00, 0x60, //          ##   
  0x00, 0xC0, //         ##    
  0x01, 0x80, //        ##     
  0x03, 0x00, //       ##      
  0x0E, 0x00, //     ###       
  0x1C, 0x00, //    ###        
  0x30, 0x00, //   ##          
  0x60, 0x00, //  ##           
  0xFF, 0xF8, // ############# 
  0xFF, 0xF8, // ############# 

  // @120 '3' (14 pixels wide)
  0x1F, 0x80, //    ######     
  0x3F, 0xC0, //   ########    
  0x70, 0xE0, //  ###    ###   
  0xE0, 0x30, // ###       ##  
  0xC0, 0x30, // ##        ##  
  0x00, 0x30, //           ##  
  0x00, 0x30, //           ##  
  0x00, 0xE0, //         ###   
  0x07, 0xC0, //      #####    
  0x07, 0xE0, //      ######   
  0x00, 0x70, //          ###  
  0x00, 0x38, //           ### 
  0x00, 0x18, //            ## 
  0x00, 0x18, //            ## 
  0xC0, 0x18, // ##         ## 
  0xC0, 0x18, // ##         ## 
  0x60, 0x30, //  ##       ##  
  0x70, 0x70, //  ###     ###  
  0x3F, 0xE0, //   #########   
  0x0F, 0x80, //     #####     

  // @160 '4' (14 pixels wide)
  0x00, 0x30, //           ##  
  0x00, 0x70, //          ###  
  0x00, 0xF0, //         ####  
  0x01, 0xF0, //        #####  
  0x01, 0xB0, //        ## ##  
  0x03, 0x30, //       ##  ##  
  0x06, 0x30, //      ##   ##  
  0x0E, 0x30, //     ###   ##  
  0x1C, 0x30, //    ###    ##  
  0x18, 0x30, //    ##     ##  
  0x30, 0x30, //   ##      ##  
  0x60, 0x30, //  ##       ##  
  0xE0, 0x30, // ###       ##  
  0xFF, 0xFC, // ##############
  0xFF, 0xFC, // ##############
  0x00, 0x30, //           ##  
  0x00, 0x30, //           ##  
  0x00, 0x30, //           ##  
  0x00, 0x30, //           ##  
  0x00, 0x30, //           ##  

  // @200 '5' (14 pixels wide)
  0x3F, 0xF0, //   ##########  
  0x3F, 0xF0, //   ##########  
  0x60, 0x00, //  ##           
  0x60, 0x00, //  ##           
  0x60, 0x00, //  ##           
  0x60, 0x00, //  ##           
  0x4F, 0x80, //  #  #####     
  0xFF, 0xE0, // ###########   
  0xF0, 0x70, // ####     ###  
  0xC0, 0x30, // ##        ##  
  0x00, 0x18, //            ## 
  0x00, 0x18, //            ## 
  0x00, 0x18, //            ## 
  0x00, 0x18, //            ## 
  0xC0, 0x18, // ##         ## 
  0xC0, 0x18, // ##         ## 
  0x60, 0x30, //  ##       ##  
  0x70, 0x60, //  ###     ##   
  0x3F, 0xE0, //   #########   
  0x0F, 0x80, //     #####     

  // @240 '6' (14 pixels wide)
  0x07, 0xC0, //      #####    
  0x1F, 0xE0, //    ########   
  0x38, 0x70, //   ###    ###  
  0x70, 0x38, //  ###      ### 
  0x60, 0x18, //  ##        ## 
  0x60, 0x00, //  ##           
  0xC0, 0x00, // ##            
  0xC7, 0x80, // ##   ####     
  0xDF, 0xE0, // ## ########   
  0xF0, 0x70, // ####     ###  
  0xE0, 0x30, // ###       ##  
  0xC0, 0x18, // ##         ## 
  0xC0, 0x18, // ##         ## 
  0xC0, 0x18, // ##         ## 
  0xC0, 0x18, // ##         ## 
  0x60, 0x18, //  ##        ## 
  0x60, 0x30, //  ##       ##  
  0x30, 0x70, //   ##     ###  
  0x1F, 0xE0, //    ########   
  0x0F, 0x80, //     #####     

  // @280 '7' (14 pixels wide)
  0xFF, 0xF8, // ############# 
  0xFF, 0xF8, // ############# 
  0x00, 0x10, //            #  
  0x00, 0x20, //           #   
  0x00, 0x60, //          ##   
  0x00, 0xC0, //         ##    
  0x00, 0x80, //         #     
  0x01, 0x80, //        ##     
  0x03, 0x00, //       ##      
  0x03, 0x00, //       ##      
  0x06, 0x00, //      ##       
  0x06, 0x00, //      ##       
  0x06, 0x00, //      ##       
  0x0C, 0x00, //     ##        
  0x0C, 0x00, //     ##        
  0x0C, 0x00, //     ##        
  0x18, 0x00, //    ##         
  0x18, 0x00, //    ##         
  0x18, 0x00, //    ##         
  0x18, 0x00, //    ##         

  // @320 '8' (14 pixels wide)
  0x0F, 0x80, //     #####     
  0x3F, 0xE0, //   #########   
  0x30, 0x60, //   ##     ##   
  0x60, 0x30, //  ##       ##  
  0x60, 0x30, //  ##       ##  
  0x60, 0x30, //  ##       ##  
  0x60, 0x30, //  ##       ##  
  0x30, 0x60, //   ##     ##   
  0x1F, 0xC0, //    #######    
  0x3F, 0xE0, //   #########   
  0x70, 0x70, //  ###     ###  
  0x60, 0x30, //  ##       ##  
  0xC0, 0x18, // ##         ## 
  0xC0, 0x18, // ##         ## 
  0xC0, 0x18, // ##         ## 
  0xC0, 0x18, // ##         ## 
  0x60, 0x30, //  ##       ##  
  0x70, 0x70, //  ###     ###  
  0x3F, 0xE0, //   #########   
  0x0F, 0x80, //     #####     

  // @360 '9' (14 pixels wide)
  0x0F, 0x80, //     #####     
  0x3F, 0xE0, //   #########   
  0x70, 0x70, //  ###     ###  
  0x60, 0x30, //  ##       ##  
  0xC0, 0x10, // ##         #  
  0xC0, 0x18, // ##         ## 
  0xC0, 0x18, // ##         ## 
  0xC0, 0x18, // ##         ## 
  0xC0, 0x18, // ##         ## 
  0x60, 0x38, //  ##       ### 
  0x70, 0x78, //  ###     #### 
  0x3F, 0xD8, //   ######## ## 
  0x0F, 0x18, //     ####   ## 
  0x00, 0x18, //            ## 
  0x00, 0x30, //           ##  
  0xC0, 0x30, // ##        ##  
  0xE0, 0x30, // ###       ##  
  0x70, 0xE0, //  ###    ###   
  0x3F, 0xC0, //   ########    
  0x1F, 0x00, //    #####  
 
  0xFF, 0xC7, 0x00, // ##########   ### 
  0xFF, 0xC8, 0x80, // ##########  #   #
  0x0C, 0x08, 0x80, //     ##      #   #
  0x0C, 0x08, 0x80, //     ##      #   #
  0x0C, 0x07, 0x00, //     ##       ### 
  0x0C, 0x00, 0x00, //     ##           
  0x0C, 0x00, 0x00, //     ##           
  0x0C, 0x00, 0x00, //     ##           
  0x0C, 0x00, 0x00, //     ##           
  0x0C, 0x00, 0x00, //     ##           
  0x0C, 0x00, 0x00, //     ##           
  0x0C, 0x00, 0x00, //     ##           
  0x0C, 0x00, 0x00, //     ##           
  0x0C, 0x00, 0x00, //     ##       `

  0xC0, 0x00, 0x00, 0x0D, 0x80, // ##                          ## ##      
  0xC0, 0x00, 0x00, 0x0D, 0x80, // ##                          ## ##      
  0xC0, 0x00, 0x00, 0x19, 0x80, // ##                         ##  ##      
  0xC0, 0x00, 0x00, 0x19, 0x80, // ##                         ##  ##      
  0xC7, 0x6E, 0x3C, 0x19, 0xBC, // ##   ### ## ###   ####     ##  ## #### 
  0xCE, 0x7F, 0x7E, 0x31, 0xFE, // ##  ###  ####### ######   ##   ########
  0xDC, 0x73, 0xCE, 0x31, 0xCE, // ## ###   ###  ####  ###   ##   ###  ###
  0xF8, 0x61, 0x86, 0x31, 0x86, // #####    ##    ##    ##   ##   ##    ##
  0xF8, 0x61, 0x86, 0x31, 0x86, // #####    ##    ##    ##   ##   ##    ##
  0xFC, 0x61, 0x86, 0x61, 0x86, // ######   ##    ##    ##  ##    ##    ##
  0xCC, 0x61, 0x86, 0x61, 0x86, // ##  ##   ##    ##    ##  ##    ##    ##
  0xCE, 0x61, 0x86, 0x61, 0x86, // ##  ###  ##    ##    ##  ##    ##    ##
  0xC6, 0x61, 0x86, 0xC1, 0x86, // ##   ##  ##    ##    ## ##     ##    ##
  0xC7, 0x61, 0x86, 0xC1, 0x86, // ##   ### ##    ##    ## ##     ##    ##
  */
